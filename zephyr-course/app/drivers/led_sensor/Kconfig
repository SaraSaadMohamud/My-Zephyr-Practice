## zephyr-course/app/drivers/led_sensor/Kconfig
```kconfig
config OUR_LED_SENSOR
    bool "Our Led Sensor Driver"
    default y
    depends on SENSOR && GPIO
```

## zephyr-course/boards/my_board/board.yml
```yaml
board:
  name: my_board
  full_name: my_board
  vendor: iomico
  socs:
    - name: stm32f407xx
```

## zephyr-course/boards/my_new_board/board.yml
```yaml
board:
  name: my_new_board
  full_name: My Board FROM SCRATCH 
  vendor: iomico
  socs:
    - name: stm32f407xx
```
