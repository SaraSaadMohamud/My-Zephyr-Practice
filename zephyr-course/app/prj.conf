## CMakeLists.txt
```
cmake_minimum_required(VERSION 3.20.0)


list(APPEND BOARD_ROOT ${CMAKE_CURRENT_SOURCE_DIR}/..)

find_package(Zephyr REQUIRED)
project(my_zephyr_app)

target_sources(app PRIVATE src/main.cpp)
add_subdirectory(drivers/led_sensor)
```

## Kconfig
```
menu "Application Configuration"

config APP_HEARTBEAT_PERIOD_MS
    int "Heartbeat LED period (ms)"
    default 500
    range 100 2000
    help
        Time between heartbeat LED toggles in milliseconds.

endmenu

rsource "drivers/led_sensor/Kconfig"
source "Kconfig.zephyr"
```

## prj.conf
```kconfig
CONFIG_GPIO=y
CONFIG_LOG=y
CONFIG_SENSOR=y
CONFIG_OUR_LED_SENSOR=y
CONFIG_SHELL=y
 
CONFIG_SHELL=y
CONFIG_SERIAL=y
CONFIG_CONSOLE=y
CONFIG_UART_CONSOLE=y
```

## app.overlay
```dts
/ {
	aliases{
		app-led = &green_led_4;
	};

	our_driver0: our_driver{
		compatible = "our,led-sensor";
		led-gpios = <&gpiod 12 GPIO_ACTIVE_HIGH>;
		status = "okay";
	};
};
```

## dts/bindings/sensor/our,led-sensor.yaml
```yaml
description: Simple GPIO LED Sensor Driver

compatible: "our,led-sensor"

include: base.yaml

properties:
  led-gpios:
    type: phandle-array
    required: true
    description: GPIO connected to the onboard LED
```

## src/main.cpp
```c
/*#include <zephyr/device.h>
#include <zephyr/drivers/sensor.h>
#include <zephyr/kernel.h>
#include <zephyr/logging/log.h>

#include "../drivers/led_sensor/led_sensor.h"

LOG_MODULE_REGISTER(main, LOG_LEVEL_INF);

#define SENSOR_NODE DT_NODELABEL(our_driver0)

int main()
{
    const struct device *driver = DEVICE_DT_GET(SENSOR_NODE);

    if (!device_is_ready(driver)) {
        LOG_ERR("LED sensor driver is not ready");
        return 0;
    }

    while(1){
        int ret = led_sensor_set_enabled(driver, false);

    if (ret < 0) {
        LOG_ERR("Failed to disable LED sensor: %d", ret);
        return 0;
    }

    ret = sensor_sample_fetch(driver);

    LOG_INF("Fetch while disabled: %d", ret);

    ret = led_sensor_set_enabled(driver, true);

    if (ret < 0) {
        LOG_ERR("Failed to enable LED sensor: %d", ret);
        return 0;
    }

    ret = sensor_sample_fetch(driver);

    if (ret < 0) {
        LOG_ERR("sensor_sample_fetch failed: %d", ret);
        return 0;
    }

    LOG_INF("Fetch while enabled succeeded");

    k_msleep(1000);

    struct sensor_value val = {};

    ret = sensor_channel_get(
        driver,
        SENSOR_CHAN_AMBIENT_TEMP,
        &val
    );

    if (ret < 0) {
        LOG_ERR("sensor_channel_get failed: %d", ret);
        return 0;
    }

    LOG_INF("sensor_channel_get succeeded");
    k_msleep(1000);
    }
    

    return 0;
}*/

#include <zephyr/kernel.h>
#include <zephyr/logging/log.h>

LOG_MODULE_REGISTER(main, LOG_LEVEL_INF);

int main(void)
{
    LOG_INF("LED Sensor Shell application started");

    return 0;
}
```
